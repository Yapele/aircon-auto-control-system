#include <IRremote.h>

IRsend irsend;
const int inPin = A0; // analog pin for Temp sensor
int statusLED = 13; //ON/OFF Led
int hold=0;        //makes sure that the serial only sends once
unsigned int aircontempup[228] = {3350,1650,450,1250,400,1250,350,450,450,400,400,400,450,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400,450};
unsigned int aircontempdown[228] = {3400,1600,450,1200,450,1200,450,400,450,350,450,400,450,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350,450};
unsigned int coldmode[228] = {3300,1700,350,1300,350,1300,350,500,350,450,350,500,350,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400,450};
unsigned int fanspeed[228] = {3350,1650,400,1250,400,1250,400,450,400,400,400,450,400,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400,400};
unsigned int airconpoweroff[228] = {3350,1700,450,1200,400,1250,400,400,400,450,400,400,400,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400,450};
unsigned int airconpoweron[228] = 
{3350,1650,400,1250,450,1250,350,500,350,450,400,400,450,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450,400};

void setup()
{
  Serial.begin(9600);
    pinMode(statusLED, OUTPUT); 
  pinMode(9,OUTPUT); // The library initializes pin 9 as an output
  digitalWrite(9, LOW);// Since our IR LED is connected to pin 9 on the Mega
}

void loop() {
  
 ///////////////TEMPERATURE SENSOR/////////////////////// 
  int value = analogRead(inPin);
  float millivolts = (value / 1024.0) * 5000;
  int celsius = millivolts / 10; // sensor output is 10mV per degree Celsius
  Serial.println(celsius);        
  delay(1000); 
////////////////////////////////////////////////////////


  if(Serial.available()){     
  char state = Serial.read();   //receive from temp sensor
   hold=0;
 switch (state)
      {
        
        case '0': 
        if(hold == 0){
         irsend.sendRaw(airconpoweroff,228,38);  //code from array, bits, frequency
         digitalWrite(statusLED, LOW);
         Serial.println("a");
         delay(1000); 
        }
         hold = 1;     //send only once    
        break;
        
         case '1': 
         if(hold == 0){
         irsend.sendRaw(airconpoweron,228,38);  //code from array, bits, frequency
         Serial.println("b");
         digitalWrite(statusLED, HIGH);
         delay(1000);  
         }
         hold = 1;     //send only once   
        break;
        
         case '2': 
         if(hold == 0){
         irsend.sendRaw(aircontempup,228,38);  //code from array, bits, frequency
         Serial.println("u");
         delay(1000); 
          }
         hold = 1;     //send only once
        break;
        
         case '3': 
         if(hold == 0){
         irsend.sendRaw(aircontempdown,228,38);  //code from array, bits, frequency
         Serial.println("d");
         delay(1000);   
         }
         hold = 1;     //send only once         
        break;
        
         case '4': 
         if(hold == 0){
         irsend.sendRaw(coldmode,228,38);  //code from array, bits, frequency
         Serial.println("m");
         delay(1000);  
         }
         hold = 1;     //send only once         
        break;
        
         case '5': 
         if(hold == 0){
         irsend.sendRaw(fanspeed,228,38);  //code from array, bits, frequency
         Serial.println("f");
         delay(1000);   
         }
         hold = 1;     //send only once         
        break;
       }  
  } 
 }

